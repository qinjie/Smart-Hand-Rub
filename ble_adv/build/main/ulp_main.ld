/* Variable definitions for ESP32ULP linker
 * This file is generated automatically by esp32ulp_mapgen.py utility.
 */

PROVIDE ( ulp_entry = 0x50000000 );
PROVIDE ( ulp_exit = 0x5000005c );
PROVIDE ( ulp_high_thr = 0x5000007c );
PROVIDE ( ulp_last_result = 0x50000084 );
PROVIDE ( ulp_low_thr = 0x50000078 );
PROVIDE ( ulp_sample_counter = 0x50000080 );
PROVIDE ( ulp_wake_up = 0x50000060 );
